## Kconfig
```kconfig
menu "ZeroPack Configuration"
  config ZP_STACK_SIZE
    int "RX task stack size (bytes)"
    default 4096
    range 2048 32768
    help
      Stack size allocated in bytes for the static FreeRTOS receive worker task.
endmenu
```
